## Firmware/ESP32/main/Kconfig
```kconfig
menu "OGXMini Options"

    config I2C_RING_BUFFER_SIZE
        int "Set I2C ring buffer size"
        default 6

    config I2C_PORT
        int "Set I2C port"
        default 0

    config I2C_SDA_PIN
        int "Set I2C SDA pin"
        default 21

    config I2C_SCL_PIN
        int "Set I2C SCL pin"
        default 22

    config I2C_BAUDRATE
        int "Set I2C baudrate"
        default 400000

    config RESET_PIN
        int "Set reset pin"
        default 9

    config MULTI_SLAVE_MODE
        bool "Enable multiple slave devices"
        default n

    config PAIR_BUTTON_PIN
        int "Set pairing button pin"
        default 255

    config PAIRING_MODE_WINDOW_MS
        int "Set pairing mode timeout in milliseconds"
        default 60000

    config ENABLE_OLED_DISPLAY
        bool "Enable SSD1306 OLED status display"
        default n

    config OLED_I2C_ADDRESS
        hex "Set OLED I2C address"
        default 0x3C
        depends on ENABLE_OLED_DISPLAY

    config ENABLE_LED_1
        bool "Enable LED 1"
        default y

    config LED_PIN_1
        int "Set LED 1 pin"
        default 15
        depends on ENABLE_LED_1

    config ENABLE_LED_2
        bool "Enable LED 2"
        default n
        depends on ENABLE_LED_1

    config LED_PIN_2
        int "Set LED 2 pin"
        default 255
        depends on ENABLE_LED_2

    config ENABLE_LED_3
        bool "Enable LED 3"
        default n
        depends on ENABLE_LED_2

    config LED_PIN_3
        int "Set LED 3 pin"
        default 255
        depends on ENABLE_LED_3

    config ENABLE_LED_4
        bool "Enable LED 4"
        default n
        depends on ENABLE_LED_3

    config LED_PIN_4
        int "Set LED 4 pin"
        default 255
        depends on ENABLE_LED_4
    
endmenu
```
